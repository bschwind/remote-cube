## components/networking/Kconfig.projbuild
```kconfig
menu "GameCube Networking Config"

    config ESP_WIFI_SSID
        string "WiFi SSID"
        default "myssid"
        help
            SSID (network name) for the example to connect to.

    config ESP_WIFI_PASSWORD
        string "WiFi Password"
        default "mypassword"
        help
            WiFi password (WPA or WPA2) for the example to use.

    config ESP_MAXIMUM_RETRY
        int "Maximum retry"
        default 5
        help
            Set the Maximum retry to avoid station reconnecting to the AP unlimited when the AP is really inexistent.

    config ESP_SERVER_IP
        string "UDP server IP"
        default "192.168.1.100"
        help
            IP of the server-mode ESP32 that will receive packets (used for client only).

    config ESP_SERVER_PORT
        int "UDP server port"
        default 5000
        help
            Port of the UDP server (used for both client and server).
endmenu
```

## main/Kconfig.projbuild
```kconfig
menu "Remote GameCube"

    choice CORE_COUNT
        prompt "ESP32 Core Count"
        default CUBE_DUAL_CORE
        help
            Select whether this will be deployed on a single-core or dual-core ESP32.

        config CUBE_SINGLE_CORE
            bool "Single Core"
            help
                Use a single-core ESP32.

        config CUBE_DUAL_CORE
            bool "Dual Core"
            help
                Use a dual-core ESP32.

    endchoice

    choice NETWORK_CONNECTIVITY
        prompt "Network Connection"
        default CUBE_USE_WIFI
        help
            Select Wi-Fi or Ethernet connectivity

        config CUBE_USE_WIFI
            bool "WiFi"
            help
                Use WiFi to connect to the network.

        config CUBE_USE_ETHERNET
            bool "Ethernet"
            help
                Use ethernet to connect to the network.

    endchoice

    if CUBE_USE_WIFI
        config ESP_WIFI_SSID
            string "WiFi SSID"
            default "myssid"
            help
                SSID (network name) to connect to.

        config ESP_WIFI_PASSWORD
            string "WiFi Password"
            default "mypassword"
            help
                WiFi password (WPA or WPA2) to use.
    endif

    choice CONTROLLER_SIDE
        prompt "Controller Side"
        default CUBE_SENDER
        help
            Select whether this will be a sender or receiver of network controller data.

        config CUBE_SENDER
            bool "Sender"
            help
                Sends controller data over the network to a remote ESP32.

        config CUBE_RECEIVER
            bool "Receiver"
            help
                Receives controller data over the network from a remote ESP32 and plays it back on a console locally.

    endchoice

    if CUBE_SENDER
        config ESP_SERVER_IP
            string "UDP server IP"
            default "192.168.1.100"
            help
                IP of the remote ESP32 that will receive packets.

        config ESP_SERVER_PORT
            int "UDP server port"
            default 5000
            help
                Port of the remote ESP32 that will receive packets.

    endif

    if CUBE_RECEIVER
        config ESP_SERVER_PORT
            int "UDP server port"
            default 5000
            help
                Port to bind to for receiving network packets.

    endif

endmenu
```

## sdkconfig.defaults
```kconfig
#
# ESP32-specific
#
# CONFIG_ESP32_DEFAULT_CPU_FREQ_80 is not set
# CONFIG_ESP32_DEFAULT_CPU_FREQ_160 is not set
CONFIG_ESP32_DEFAULT_CPU_FREQ_240=y
CONFIG_ESP32_DEFAULT_CPU_FREQ_MHZ=240

#
# Ethernet
#
CONFIG_ETH_ENABLED=y
CONFIG_ETH_USE_ESP32_EMAC=y
CONFIG_ETH_PHY_INTERFACE_RMII=y
# CONFIG_ETH_PHY_INTERFACE_MII is not set
# CONFIG_ETH_RMII_CLK_INPUT is not set
CONFIG_ETH_RMII_CLK_OUTPUT=y
# CONFIG_ETH_RMII_CLK_OUTPUT_GPIO0 is not set
CONFIG_ETH_RMII_CLK_OUT_GPIO=17
CONFIG_ETH_DMA_BUFFER_SIZE=512
CONFIG_ETH_DMA_RX_BUFFER_NUM=10
CONFIG_ETH_DMA_TX_BUFFER_NUM=10
# CONFIG_ETH_USE_SPI_ETHERNET is not set
# CONFIG_ETH_USE_OPENETH is not set
# end of Ethernet
```
